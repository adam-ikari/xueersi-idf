## main/Kconfig.projbuild
```kconfig
menu "Xiaomiao Configuration"

    config XIAOMIAO_USE_SDL
        bool "Use SDL3 demo instead of LVGL dashboard"
        default y
        help
            Enable the SDL3-based hardware demo instead of the original
            LVGL dashboard. The SDL demo proves video + input backends work
            before switching to the full paged UI.

endmenu
```

## sdkconfig.defaults
```kconfig
CONFIG_FREERTOS_HZ=1000
CONFIG_ESP_DEFAULT_CPU_FREQ_MHZ_240=y
CONFIG_ESP_DEFAULT_CPU_FREQ_MHZ=240
CONFIG_ESPTOOLPY_FLASHMODE_QIO=y
# CONFIG_ESPTOOLPY_FLASHMODE_DIO is not set
CONFIG_ESPTOOLPY_FLASHFREQ_80M=y
CONFIG_ESPTOOLPY_FLASHFREQ="80m"
# CONFIG_ESPTOOLPY_FLASHSIZE_2MB is not set
CONFIG_ESPTOOLPY_FLASHSIZE_4MB=y
CONFIG_ESPTOOLPY_FLASHSIZE="4MB"
CONFIG_PARTITION_TABLE_OFFSET=0x9000
CONFIG_COMPILER_OPTIMIZATION_PERF=y
CONFIG_BOOTLOADER_COMPILER_OPTIMIZATION_PERF=y
CONFIG_SPIRAM=y
CONFIG_SPIRAM_MODE_QUAD=y
CONFIG_SPIRAM_TYPE_AUTO=y
CONFIG_SPIRAM_SPEED_80M=y
CONFIG_SPIRAM_SPEED=80
CONFIG_SPIRAM_OCCUPY_VSPI_HOST=y
CONFIG_SPIRAM_USE_MALLOC=y
CONFIG_SPI_MASTER_IN_IRAM=y
CONFIG_SPI_MASTER_ISR_IN_IRAM=y
CONFIG_SDL_BSP_XIAOMIAO=y
# CONFIG_SDL_BSP_ESP_BOX_3 is not set
# CONFIG_SDL_BSP_ESP32_C6_DEVKIT is not set
# CONFIG_SDL_BSP_M5STACK_CORE_S3 is not set
# CONFIG_SDL_BSP_M5_ATOM_S3 is not set
# CONFIG_SDL_BSP_ESP32_C3_LCDKIT is not set
# CONFIG_SDL_BSP_ESP32_P4_FUNCTION_EV is not set
# CONFIG_SDL_BSP_ESP32_S3_LCD_EV_BOARD is not set
# CONFIG_SDL_BSP_M5STACK_TAB5 is not set
# CONFIG_SDL_BSP_TOUCH_ENABLE is not set
# CONFIG_PARTITION_TABLE_SINGLE_APP is not set
CONFIG_PARTITION_TABLE_SINGLE_APP_LARGE=y
# CONFIG_WAMR_ENABLE_APP_FRAMEWORK is not set
# CONFIG_WAMR_ENABLE_LIB_PTHREAD is not set
CONFIG_WAMR_ENABLE_LIBC_BUILTIN=y
CONFIG_WAMR_ENABLE_LIBC_WASI=y
```
